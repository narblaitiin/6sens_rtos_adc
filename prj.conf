## CMakeLists.txt
```
cmake_minimum_required(VERSION 3.20.0)

find_package(Zephyr REQUIRED HINTS $ENV{ZEPHYR_BASE})
project(6sens_rtos_adc)

FILE(GLOB app_sources src/*.c)
target_sources(app PRIVATE ${app_sources})
```

## prj.conf
```kconfig
# Debugger Support
CONFIG_UART_CONSOLE=n
CONFIG_CONSOLE=y
CONFIG_SERIAL=y

# RTT Segger Support
CONFIG_RTT_CONSOLE=y
CONFIG_USE_SEGGER_RTT=y

# Communication Bus Support
CONFIG_GPIO=y
CONFIG_SPI=y

# Hardware Support
CONFIG_ADC=y

# Flash Memory Support (MX25R64)
CONFIG_FLASH=y
CONFIG_MPU_ALLOW_FLASH_WRITE=y
CONFIG_NORDIC_QSPI_NOR=y
```

## boards/mdbt50q_lora_dev.overlay
```dts
/*
 * Copyright (c) 2025
 * Regis Rousseau
 * Univ Lyon, INSA Lyon, Inria, CITI, EA3720
 * SPDX-License-Identifier: Apache-2.0
 */

/* Sismic sensor analog value conversion */
/* external ADC channnel of MDBT50Q, Port P0.02 on schematic */
/ {
	zephyr,user {
		io-channels = <&adc 0>;
	};
};

/* enable the corresponding ADC, with the correct configuration */
&adc {
	#address-cells = <1>;
	#size-cells = <0>;
	status = "okay";
	channel@0 {
		reg = <0>;											/* channel 0 of the ADC */
		zephyr,gain = "ADC_GAIN_1_6";						/* attenuated by 6 (x1/6) */
		zephyr,reference = "ADC_REF_INTERNAL";				/* reference voltage +0.6V */
		zephyr,acquisition-time = <ADC_ACQ_TIME_DEFAULT>;	/* 10us */
		zephyr,input-positive = <NRF_SAADC_AIN0>;			/* P0.02 for nRF52xx */
		zephyr,resolution = <12>;
	};
};
```

## src/main.c
```c
/*
 * Copyright (c) 2025
 * Regis Rousseau
 * Univ Lyon, INSA Lyon, Inria, CITI, EA3720
 * SPDX-License-Identifier: Apache-2.0
 */

//  ========== includes ====================================================================
#include "app_eeprom.h"
#include "app_adc.h"

#include <zephyr/kernel.h>
#include <stdbool.h>
#include <stdio.h>

//  ========== interrupt sub-routine =======================================================
void geo_work_handler(struct k_work *work_geo)
{
	const struct device *rom_dev = DEVICE_DT_GET(SPI_FLASH_DEVICE);

	printk("ADC handler called\n");
	app_eeprom_handler(rom_dev);

	printk("test only sensor connected on ADC P0.02\n");
	int16_t value = app_nrf52_get_adc();
}
K_WORK_DEFINE(geo_work, geo_work_handler);

void geo_timer_handler(struct k_timer *geo_dum)
{
	k_work_submit(&geo_work);
}
K_TIMER_DEFINE(geo_timer, geo_timer_handler, NULL);

// ========== main =========================================================================
int8_t main(void)
{
	// initialize ADC device
	int8_t ret = app_nrf52_adc_init();
	if (ret != 1) {
		printk("failed to initialize ADC device\n");
		return 0;
	}

	// retrieve the EEPROM device
	const struct device *flash_dev = DEVICE_DT_GET(SPI_FLASH_DEVICE);
	ret = app_eeprom_init(flash_dev);
	if (ret != 1) {
		printk("failed to initialize QSPI Flash device\n");
		return 0;
	}

	printk("ADC nRF52 and QSPI Flash EEPROM Example\n");

	// start the timer to trigger the interrupt subroutine every 5 seconds
	k_timer_start(&geo_timer, K_NO_WAIT, K_MSEC(1000));
	return 0;
}
```

## src/app_adc.c
```c
/*
 * Copyright (c) 2025
 * Regis Rousseau
 * Univ Lyon, INSA Lyon, Inria, CITI, EA3720
 * SPDX-License-Identifier: Apache-2.0
 */

//  ========== includes ====================================================================
#include "app_adc.h"

//  ========== globals =====================================================================
// ADC buffer to store raw ADC readings
int16_t buf;

// ADC channel configuration obtained from the device tree
static const struct adc_dt_spec adc_channel = ADC_DT_SPEC_GET(DT_PATH(zephyr_user));

// ADC sequence configuration to specify the ADC operation
static struct adc_sequence sequence = {
    .channels = 0,
	.buffer = &buf,
	.buffer_size = sizeof(buf),
};

//  ========== app_nrf52_adc_init ==========================================================
int8_t app_nrf52_adc_init()
{
    int8_t ret;

    // verify if the ADC is ready for operation
    if (!adc_is_ready_dt(&adc_channel)) {
		printk("ADC is not ready. error: %d\n", ret);
		return 0;
    }
    
    // configure the ADC channel settings
    ret = adc_channel_setup_dt(&adc_channel);
	if (ret < 0) {
		printk("failed to set up ADC channel. error: %d\n", ret);
		return 0;
	}

    // initialize the ADC sequence for continuous or single readings
    ret = adc_sequence_init_dt(&adc_channel, &sequence);
	if (ret < 0) {
		printk("failed to initialize ADC sequence. error: %d\n", ret);
		return 0;
	}
    return 1;
}

//  ========== app_nrf52_get_adc ===========================================================
int16_t app_nrf52_get_adc()
{
    int16_t velocity;       // converted voltage value in mV
    int8_t ret;
    
    // trigger an ADC read and store the result in the configured buffer
    ret = adc_read(adc_channel.dev, &sequence);
    if (ret < 0) {        
	    printk("failed to read raw ADC value. error: %d\n", ret);
	    return 0;
    }

    printk("raw adc value: %d\n", buf);

    // convert the raw ADC reading into a voltage value (in millivolts)
    velocity = (buf * ADC_FULL_SCALE_MV) / ADC_RESOLUTION;
    printk("velocity: %d mV\n", velocity);
    return (int16_t)velocity;
}
```

## src/app_adc.h
```c
/*
 * Copyright (c) 2025
 * Regis Rousseau
 * Univ Lyon, INSA Lyon, Inria, CITI, EA3720
 * SPDX-License-Identifier: Apache-2.0
 */

#ifndef APP_ADC_H
#define APP_ADC_H

//  ========== includes ====================================================================
#include <zephyr/kernel.h>
#include <zephyr/device.h>
#include <zephyr/devicetree.h>
#include <zephyr/drivers/adc.h>

//  ========== defines =====================================================================
// ADC characteristics (nRF52 SAADC)
#define ADC_REF_INTERNAL_MV         600     // 0.6 V internal reference
#define ADC_GAIN                    6       // using ADC_GAIN_1_6 -> 1/6
//#define ADC_RESOLUTION              4096    // 12-bit
#define ADC_RESOLUTION              16384   // 14-bit

// effective full-scale voltage in mV
#define ADC_FULL_SCALE_MV   ((ADC_REF_INTERNAL_MV * ADC_GAIN))  // 3600 mV full scale

//  ========== prototypes ==================================================================
int8_t app_nrf52_adc_init();
int16_t app_nrf52_get_adc();

#endif /* APP_ADC_H */
```

## src/app_eeprom.c
```c
/*
 * Copyright (c) 2025
 * Regis Rousseau
 * Univ Lyon, INSA Lyon, Inria, CITI, EA3720
 * SPDX-License-Identifier: Apache-2.0
 */

//  ========== includes ====================================================================
#include "app_eeprom.h"

//  ========== app_eeprom_init =============================================================
int8_t app_eeprom_init(const struct device *dev)
{
	// check if the EEPROM device is ready
	if (!device_is_ready(dev)) {
		printk("%s: device is not ready\n", dev->name);
		return -1;
	}

	// erase the data storage partition
	int8_t ret = flash_erase(dev, SPI_FLASH_OFFSET, SPI_FLASH_SECTOR_SIZE*SPI_FLASH_SECTOR_NB);
	if (ret != 0){
		printf("MX25R64 flash erase failed. error: %d\n", ret);
		return -1;
	} else {
		printk("MX25R64 flash erase succeeded\n");
	}	
	return 1;
}

//  ========== app_eeprom_write ============================================================
// write data to EEPROM
int8_t app_eeprom_write(const struct device *dev, const uint8_t *data, size_t length)
{
    int8_t ret = flash_write(dev, SPI_FLASH_OFFSET, data, length);
    if (ret != 0) {
        printk("error writing data. Error: %d\n", ret);
        return -1;
    }
    printk("successfully wrote %zu bytes to address 0x%X\n", length, SPI_FLASH_OFFSET);
    return 0;
}

//  ========== app_rom_read ================================================================
// read data from EEPROM
int8_t app_eeprom_read(const struct device *dev, uint8_t *data, size_t length)
{
    int ret = flash_read(dev, SPI_FLASH_OFFSET, data, length);
    if (ret != 0) {
        printk("error reading data. Error: %d\n", ret);
        return -1;
    }
    printk("successfully read %zu bytes from address 0x%X\n", length, SPI_FLASH_OFFSET);
    return 0;
}

//  ======== app_rom_handler ===============================================================
int8_t app_eeprom_handler(const struct device *dev)
{
    uint8_t buffer[2*MAX_RECORDS] = {0};        // enough space for tADC data
    int16_t adc_data[MAX_RECORDS] = {0};

    if (!device_is_ready(dev)) {
        printk("%s: device is not ready\n", dev->name);
        return -1;
    }

    // get ADC data and serialize it into the buffer
    for (int i = 0; i < MAX_RECORDS; i++) {
        adc_data[i] = app_nrf52_get_adc();
        buffer[i * 2] = (adc_data[i] >> 8) & 0xFF;     // high byte
        buffer[i * 2 + 1] = adc_data[i] & 0xFF;        // low byte
    }

    // write buffer to EEPROM
    if (app_eeprom_write(dev, buffer, sizeof(buffer)) != 0) {
        return -1;
    }

    k_sleep(K_MSEC(2000));

    // read back and verify
    uint8_t read_buffer[256] = {0};
    if (app_eeprom_read(dev, read_buffer, sizeof(read_buffer)) != 0) {
        return -1;
    }

    // deserialize and print ADC data
    for (int i = 0; i < MAX_RECORDS; i++) {
        int16_t read_adc = (read_buffer[i * 2] << 8) | read_buffer[i * 2 + 1];
        printk("read ADC value [%d]: %d\n", i, read_adc);
    }
    return 0;
}
```

## src/app_eeprom.h
```c
/*
 * Copyright (c) 2025
 * Regis Rousseau
 * Univ Lyon, INSA Lyon, Inria, CITI, EA3720
 * SPDX-License-Identifier: Apache-2.0
 */

#ifndef APP_EEPROM_H
#define APP_EEPROM_H

//  ========== includes ====================================================================
#include <zephyr/kernel.h>
#include <zephyr/device.h>
#include <zephyr/devicetree.h>
#include <zephyr/drivers/flash.h>

//  ========== defines =====================================================================
#define SPI_FLASH_DEVICE        DT_COMPAT_GET_ANY_STATUS_OKAY(nordic_qspi_nor)
#define SPI_FLASH_OFFSET		0x00000
#define SPI_FLASH_SECTOR_SIZE	4096   // in bytes
#define SPI_FLASH_SECTOR_NB     1
#define MAX_RECORDS             128    // max number of ADC records                     

//  ========== prototypes ==================================================================
int8_t app_eeprom_init(const struct device *dev);
int8_t app_eeprom_write(const struct device *dev, const uint8_t *data, size_t length);
int8_t app_eeprom_read(const struct device *dev, uint8_t *data, size_t length);
int8_t app_eeprom_handler(const struct device *dev);

#endif /* APP_EEPROM_H */
```
